## config/west.yml
```yaml
---
manifest:
  remotes:
    - name: zmkfirmware
      url-base: https://github.com/zmkfirmware
    - name: hitsmaxft
      url-base: https://github.com/hitsmaxft
    - name: urob
      url-base: https://github.com/urob

  projects:
    - name: zmk
      remote: zmkfirmware
      revision: 0331b7d16e80954b807917f9323e59ffc1e3b626 # main (4/19/2026)
      clone-depth: 1
      import:
        file: app/west.yml

    # ZMK modules (urob)
    - name: zmk-adaptive-key
      remote: urob
      path: modules/zmk/adaptive-key
      revision: 18cc2795a64ccb394d1a7b7d591a5bfe3f25924b # main (4/19/2026)
    - name: zmk-auto-layer
      remote: urob
      path: modules/zmk/auto-layer
      revision: dfa7c695ffde41ef8064245453595d50e198ae1d # main (4/19/2026)
    - name: zmk-helpers
      remote: urob
      path: modules/zmk/helpers
      revision: 0b9e9d1dd9e86f70b4c8c2b0fab55c4f90c9d2e3 # main (4/19/2026)
    - name: zmk-leader-key
      remote: urob
      path: modules/zmk/leader-key
      revision: 749f7faf65cc4105c82fbe64cfaa7e09a8a63605 # main (4/19/2026)
    - name: zmk-tri-state
      remote: urob
      path: modules/zmk/tri-state
      revision: 2007896c6d5bfb519e8babccf8633841c5647d8b # main (4/19/2026)
    - name: zmk-unicode
      remote: urob
      path: modules/zmk/unicode
      revision: 1a6dbc797a46c4a61c3c71a7a9d013a5d5aee49e # main (4/19/2026)

    # Dongle display
    - name: zmk-dongle-display
      remote: hitsmaxft
      revision: 8e8d618aefbeb6dcaeb0f539b35b9530d783fbfa # zephyr4 (4/21/2026)

  self:
    path: config
```
