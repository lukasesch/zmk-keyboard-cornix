/*
 * Copyright (c) 2020 The ZMK Contributors
 *
 * SPDX-License-Identifier: MIT
 */

/*
 * Cornix 50-key wrapper for urob's 34-key base.keymap.
 *
 * Matrix positions (0-49):
 *
 *  Row 0: LT5 LT4 LT3 LT2 LT1 LT0 │ RT0 RT1 RT2 RT3 RT4 RT5
 *  Row 1: LM5 LM4 LM3 LM2 LM1 LM0 │ RM0 RM1 RM2 RM3 RM4 RM5
 *  Row 2: LB5 LB4 LB3 LB2 LB1 LB0 LH3 │ RH3 RB0 RB1 RB2 RB3 RB4 RB5
 *  Row 3: LP2 LP1 LP0 LH2 LH1 LH0 │ RH0 RH1 RH2 RP0 RP1 RP2
 *
 * The inner 5 columns per side (LT4-LT0, RT0-RT4, etc.) receive urob's
 * 34-key layout. Outer columns and extra thumb/palm keys get fixed bindings.
 *
 * Encoder knobs: LH3(pos 30) / RH3(pos 31) = press play/pause
 *                Rotation = volume up/down (via sensor-bindings)
 */

#define CONFIG_WIRELESS

/* Custom wrapper: generates full DTS layer node with sensor-bindings for
 * the Cornix's two EC11 rotary encoders (volume up/down on both). */
#define ZMK_BASE_LAYER(LNAME, LT, RT, LM, RM, LB, RB, LH, RH)               \
    / { keymap { compatible = "zmk,keymap";                                    \
        LNAME {                                                                \
            display-name = #LNAME;                                              \
            bindings = <                                                       \
                &kp F13    LT                                      RT     &kp BSPC  \
                &kp F14    LM                                      RM     &none     \
                &kp F15    LB                  &kp C_PP  &kp C_PP  RB     &none     \
                &kp F16 &none &none &mo WINMGMT  LH          RH  &smart_mouse &none &none &none \
            >;                                                                 \
            sensor-bindings = <&inc_dec_kp C_VOL_UP C_VOL_DN &inc_dec_kp C_VOL_UP C_VOL_DN>; \
        };                                                                     \
    }; };

#include "includes/cornix54.h"
#include "base.keymap"
