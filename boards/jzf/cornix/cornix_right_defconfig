## boards/jzf/cornix/cornix_right_defconfig
```kconfig
# SPDX-License-Identifier: MIT

CONFIG_ADC_NRFX_SAADC=y

# Enable MPU
CONFIG_ARM_MPU=y

# Use pinctrl
CONFIG_PINCTRL=y

# enable GPIO
CONFIG_GPIO=y

CONFIG_USE_DT_CODE_PARTITION=y
CONFIG_BUILD_OUTPUT_UF2=y

CONFIG_MPU_ALLOW_FLASH_WRITE=y
CONFIG_NVS=y
CONFIG_SETTINGS_NVS=y
CONFIG_FLASH=y
CONFIG_FLASH_PAGE_LAYOUT=y
CONFIG_FLASH_MAP=y
CONFIG_CLOCK_CONTROL_NRF=y
CONFIG_CLOCK_CONTROL_NRF_K32SRC_XTAL=y
CONFIG_CLOCK_CONTROL_NRF_K32SRC_20PPM=y

CONFIG_ZMK_SPLIT=y

CONFIG_ZMK_BLE=y

# Match TX power with central for symmetric link
CONFIG_BT_CTLR_TX_PWR_PLUS_8=y

# Bonds: peripheral only needs central
CONFIG_BT_MAX_CONN=1
CONFIG_BT_MAX_PAIRED=1

# never output usb
CONFIG_ZMK_USB=n

CONFIG_INPUT=y

# RGB
#CONFIG_SPI=n
#CONFIG_ZMK_EXT_POWER=n

CONFIG_EC11=y
CONFIG_EC11_TRIGGER_GLOBAL_THREAD=y

# vim: set ft=kconfig:
```
